## dk-a5e065ab32aea-enablement/cache_coh_accel/software/yocto_linux/meta-custom/conf/layer.conf
```bitbake
# We have a conf and classes directory, add to BBPATH
BBPATH .= ":${LAYERDIR}"

# We have recipes-* directories, add to BBFILES
BBFILES += "${LAYERDIR}/recipes-*/*/*.bb \
            ${LAYERDIR}/recipes-*/*/*/*.bb \
            ${LAYERDIR}/recipes-*/*/*.bbappend"

BBFILE_COLLECTIONS += "meta_custom"
BBFILE_PATTERN_meta_custom = "^${LAYERDIR}/"
LAYERDIR_meta_custom := "${LAYERDIR}"
export LAYERDIR_meta_custom


BBFILE_PRIORITY_meta_custom = "6"

LAYERDEPENDS_meta_custom = "core"
LAYERSERIES_COMPAT_meta_custom = "wrynose"

CUSTOM_UBOOT_DT = "${CUSTOM_UBOOT_DEVICE_TREE}"
CUSTOM_LINUX_DT = "${CUSTOM_LINUX_DEVICE_TREE}"

FPGA_CORE_PGM_ENABLE = "${FPGA_ENABLE_CORE_PGM}"

SSBL_BOOT_SRC = "${SSBL_BOOT_SOURCE}"

KERNEL_BOOTARGS = "${@ ' '.join([d.getVar('KERNEL_BOOTARGS_SD_MMC') if d.getVar('SSBL_BOOT_SRC') == 'mmc0' \
    else d.getVar('KERNEL_BOOTARGS_QSPI') if d.getVar('SSBL_BOOT_SRC') == 'qspi' else ''])}"

GSRD_APP_SYSCHK ??= "true"
SYSCHK_APP = "${GSRD_APP_SYSCHK}"
GSRD_APP_LED_CTRL ??= "true"
LED_CTRL_APP = "${GSRD_APP_LED_CTRL}"
GSRD_APP_REMOTE_DEBUG ??= "false"
REMOTE_DEBUG_APP = "${GSRD_APP_REMOTE_DEBUG}"
GSRD_APP_TSN_REF_SW ??= "true"
TSN_REF_SW = "${GSRD_APP_TSN_REF_SW}"
NET_APP_LINUXPTP ??= "true"
LINUXPTP_APP = "${NET_APP_LINUXPTP}"
NET_LIB_OPEN62541 ??= "true"
OPEN62541_LIB = "${NET_LIB_OPEN62541}"
GSRD_APP_HELLO_WORLD ??= "true"
HELLO_WORLD_APP = "${GSRD_APP_HELLO_WORLD}"

# CCA demo application
CCA_DEMO_APP ??= "true"
# CCA kernel driver toggle
CCA_DRIVER_APP ??= "true"
# CCA benchmark application
CCA_BENCHMARK_APP ??= "true"

IMAGE_INSTALL:append = "${@bb.utils.contains('HELLO_WORLD_APP', 'true', ' hello', '', d)}"
IMAGE_INSTALL:append = "${@bb.utils.contains('CCA_DEMO_APP', 'true', ' cca-demo', '', d)}"
IMAGE_INSTALL:append = "${@bb.utils.contains('CCA_DRIVER_APP', 'true', ' cca-driver', '', d)}"
IMAGE_INSTALL:append = "${@bb.utils.contains('CCA_BENCHMARK_APP', 'true', ' cca-benchmark', '', d)}"
IMAGE_INSTALL:append = " rootfs-files"
IMAGE_INSTALL:append = " test-suite-agilex5"

# Add variables for wic creation of sdcard image
IMAGE_BOOT_FILES = " \
		uboot.env \
		boot.scr.uimg \
		u-boot.itb \
		kernel.itb \
		"

# Add Xen hypervisor support files including devicetree folder
IMAGE_BOOT_FILES:append = " ${@bb.utils.contains('DISTRO_FEATURES', 'xen', 'xen Image ' + d.getVar('UBOOT_DEVICE_TREE') + ';devicetree/' + d.getVar('UBOOT_DEVICE_TREE') + ' boot.scr.xen.uimg top.core.rbf', '', d)}"
```
